// Definitions for uart0 based on the original Feb 9, 2018 edition.
// Note uart0-overlay.dts created on Nov 8, 2018 is not compatible
// with Compute Modules that use UART0 and DPI.
// See https://github.com/raspberrypi/linux/issues/2856 for the details.
/dts-v1/;
/plugin/;

/{
	compatible = "brcm,bcm2708";

	fragment@0 {
		target = <&uart0>;
		__overlay__ {
			pinctrl-names = "default";
			pinctrl-0 = <&uart0_pins>;
			status = "okay";
		};
	};

	fragment@1 {
		target = <&gpio>;
		__overlay__ {
			uart0_pins: uart0_pins {
				brcm,pins = <14 15>;
				brcm,function = <4>; /* alt0 */
				brcm,pull = <0 2>;
			};
		};
	};

	__overrides__ {
		txd0_pin = <&uart0_pins>,"brcm,pins:0";
		rxd0_pin = <&uart0_pins>,"brcm,pins:4";
		pin_func = <&uart0_pins>,"brcm,function:0";
	};
};

